## examples/prov_dev_client_ll_sample/sdkconfig.defaults
```kconfig
# newlib for ESP32 and ESP8266 platform

CONFIG_NEWLIB_ENABLE=y
CONFIG_NEWLIB_LIBRARY_LEVEL_NORMAL=y
CONFIG_NEWLIB_NANO_FORMAT=
CONFIG_SSL_USING_MBEDTLS=y
CONFIG_LWIP_IPV6=y

# Enable Cryptoauthlib hardware acceleration of mbedtls
CONFIG_ATCA_MBEDTLS_ECDSA=y
CONFIG_ATCA_MBEDTLS_ECDSA_SIGN=y
CONFIG_ATCA_MBEDTLS_ECDSA_VERIFY=y
CONFIG_ESP_TLS_USE_HSM=y
```
